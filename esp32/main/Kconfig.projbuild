## esp32/main/Kconfig.projbuild
```kconfig
menu "SolarTime 配置"
    config SOLAR_LAT
        float "纬度 (北正南负)"
        default 31.2304
    config SOLAR_LON
        float "经度 (东正西负)"
        default 121.4737
    config SOLAR_TZ
        int "时区 (UTC+8 => 8)"
        default 8

    config SOLAR_GNSS
        bool "启用GNSS (ATGM336H, UART1)"
        default n
        help
            解析GNRMC, 首次定位后自动进入心跳模式
    config SOLAR_GNSS_TZ
        int "GNSS时区 (UTC+8 => 8)"
        default 8
        depends on SOLAR_GNSS
    config SOLAR_GNSS_UART_RX
        int "GNSS TXD0 -> ESP32 RX 引脚"
        default 17
        depends on SOLAR_GNSS
    config SOLAR_GNSS_UART_TX
        int "ESP32 TX -> GNSS RXD0 引脚"
        default 18
        depends on SOLAR_GNSS
    config SOLAR_GNSS_BAUD
        int "GNSS UART 波特率 (5N=9600, 6N=115200)"
        default 115200
        depends on SOLAR_GNSS

    config SOLAR_RTC
        bool "启用RTC (DS3231, I2C0, 0x68)"
        default n
    config SOLAR_RTC_SDA
        int "RTC SDA 引脚"
        default 8
        depends on SOLAR_RTC
    config SOLAR_RTC_SCL
        int "RTC SCL 引脚"
        default 9
        depends on SOLAR_RTC

    config SOLAR_LCD
        bool "启用LCD (ST7789 240x240 SPI)"
        default n
        help
            ST7789 SPI, 渲染心跳数据
    config SOLAR_LCD_PIN_SCK
        int "LCD SCK 引脚"
        default 11
        depends on SOLAR_LCD
    config SOLAR_LCD_PIN_MOSI
        int "LCD MOSI 引脚"
        default 12
        depends on SOLAR_LCD
    config SOLAR_LCD_PIN_DC
        int "LCD DC 引脚"
        default 13
        depends on SOLAR_LCD
    config SOLAR_LCD_PIN_RES
        int "LCD RES 引脚"
        default 14
        depends on SOLAR_LCD
    config SOLAR_LCD_PIN_CS
        int "LCD CS 引脚"
        default 15
        depends on SOLAR_LCD
    config SOLAR_LCD_PIN_BLK
        int "LCD BLK 引脚"
        default 16
        depends on SOLAR_LCD
endmenu
```
